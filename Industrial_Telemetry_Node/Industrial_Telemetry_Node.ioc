# file: Industrial_Telemetry_Node.ioc
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Mcu.Family=STM32F4
Mcu.Name=STM32F411V(C-E)Tx
Mcu.Package=LQFP100
NVIC.PriorityGroup=NVIC_PRIORITYGROUP_4
ProjectManager.HeapSize=0x200
ProjectManager.StackSize=0x400
ProjectManager.TargetToolchain=STM32CubeIDE
RCC.AHBFreq_Value=16000000
RCC.APB1Freq_Value=16000000
RCC.APB2Freq_Value=16000000
RCC.CortexFreq_Value=16000000
RCC.HSE_VALUE=25000000
RCC.HSI_VALUE=16000000
RCC.LSE_VALUE=32768
RCC.SYSCLKFreq_VALUE=16000000
RCC.VCOOutputFreq_Value=192000000
board=custom

// file: Core/Src/main.c
/* USER CODE BEGIN Header */
/**
  ******************************************************************************
  * @file           : main.c
  * @brief          : Main program body
  ******************************************************************************
  * @attention
  *
  * Copyright (c) 2026 STMicroelectronics.
  * All rights reserved.
  *
  * This software is licensed under terms that can be found in the LICENSE file
  * in the root directory of this software component.
  * If no LICENSE file comes with this software, it is provided AS-IS.
  *
  ******************************************************************************
  */
/* USER CODE END Header */
#include "main.h"

/* USER CODE BEGIN Includes */
#include "stm32f411xe.h"
/* USER CODE END Includes */

void SystemClock_Config(void);
void MX_GPIO_Init(void);

#include <stdint.h>

// LED-Pins
#define GRUEN   (1U << 12)
#define ORANGE  (1U << 13)
#define ROT     (1U << 14)

#define ALLE_LEDS (GRUEN | ORANGE | ROT)

// GPIO initialisieren
void gpio_init(void)
{
    // Takt für Port D einschalten
    RCC->AHB1ENR |= (1U << 3);
    (void)RCC->AHB1ENR;

    // PD12, PD13, PD14: Mode-Bits löschen
    GPIOD->MODER &= ~((3U << 24) |
                      (3U << 26) |
                      (3U << 28));

    // Als Ausgang konfigurieren (01)
    GPIOD->MODER |= (1U << 24) |
                    (1U << 26) |
                    (1U << 28);

    // Push-Pull und keine Pull-Widerstände
    GPIOD->OTYPER &= ~ALLE_LEDS;
    GPIOD->PUPDR &= ~((3U << 24) |
                      (3U << 26) |
                      (3U << 28));

    // LEDs ausschalten
    GPIOD->ODR &= ~ALLE_LEDS;
}

// SysTick für 1 ms bei 16 MHz einrichten
void systick_init(void)
{
    SysTick->LOAD = 15999;
    SysTick->VAL = 0;
    SysTick->CTRL = 0x5;
}

// Eigene Delay-Funktion
void delay_ms(uint32_t n)
{
    for (uint32_t i = 0; i < n; i++)
    {
        while ((SysTick->CTRL & (1U << 16)) == 0)
        {
        }
    }
}

// Ampel-LEDs setzen
void ampel_set(uint32_t leds)
{
    GPIOD->ODR = (GPIOD->ODR & ~ALLE_LEDS) | leds;
}

int main(void)
{
    gpio_init();
    systick_init();

    while (1)
    {
        // GRÜN: 4 Sekunden
        ampel_set(GRUEN);
        delay_ms(4000);

        // ORANGE: 1 Sekunde
        ampel_set(ORANGE);
        delay_ms(1000);

        // ROT: 4 Sekunden
        ampel_set(ROT);
        delay_ms(4000);

        // ROT + ORANGE: 1 Sekunde
        ampel_set(ROT | ORANGE);
        delay_ms(1000);
    }
}

void SystemClock_Config(void)
{
  RCC_OscInitTypeDef RCC_OscInitStruct = {0};
  RCC_ClkInitTypeDef RCC_ClkInitStruct = {0};

  /** Configure the main internal regulator output voltage
  */
  __HAL_RCC_PWR_CLK_ENABLE();
  __HAL_PWR_VOLTAGESCALING_CONFIG(PWR_REGULATOR_VOLTAGE_SCALE1);

  /** Initializes the RCC Oscillators according to the specified parameters
  * in the RCC_OscInitTypeDef structure.
  */
  RCC_OscInitStruct.OscillatorType = RCC_OSCILLATORTYPE_HSI;
  RCC_OscInitStruct.HSIState = RCC_HSI_ON;
  RCC_OscInitStruct.HSICalibrationValue = RCC_HSICALIBRATION_DEFAULT;
  RCC_OscInitStruct.PLL.PLLState = RCC_PLL_NONE;
  if (HAL_RCC_OscConfig(&RCC_OscInitStruct) != HAL_OK)
  {
    Error_Handler();
  }

  /** Initializes the CPU, AHB and APB buses clocks
  */
  RCC_ClkInitStruct.ClockType = RCC_CLOCKTYPE_HCLK|RCC_CLOCKTYPE_SYSCLK
                              |RCC_CLOCKTYPE_PCLK1|RCC_CLOCKTYPE_PCLK2;
  RCC_ClkInitStruct.SYSCLKSource = RCC_SYSCLKSOURCE_HSI;
  RCC_ClkInitStruct.AHBCLKDivider = RCC_SYSCLK_DIV1;
  RCC_ClkInitStruct.APB1CLKDivider = RCC_HCLK_DIV1;
  RCC_ClkInitStruct.APB2CLKDivider = RCC_HCLK_DIV1;

  if (HAL_RCC_ClockConfig(&RCC_ClkInitStruct, FLASH_LATENCY_0) != HAL_OK)
  {
    Error_Handler();
  }
}

void Error_Handler(void)
{
  __disable_irq();
  while (1)
  {
  }
}
